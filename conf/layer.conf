## conf/layer.conf
```bitbake
# We have a conf and classes directory, add to BBPATH
BBPATH .= ":${LAYERDIR}"

# We have recipes-* directories, add to BBFILES
BBFILES += "${LAYERDIR}/recipes-*/*/*.bb \
            ${LAYERDIR}/recipes-*/*/*.bbappend"

BBFILE_COLLECTIONS += "meta-aegis"
BBFILE_PATTERN_meta-aegis = "^${LAYERDIR}/"
BBFILE_PRIORITY_meta-aegis = "6"

LAYERDEPENDS_meta-aegis = "core"
LAYERSERIES_COMPAT_meta-aegis = "scarthgap"
```
